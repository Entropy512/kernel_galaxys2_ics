## arch/arm/mvp/Kconfig
```kconfig
config VMWARE_MVP
       bool "Build VMware Mobile Virtualization Platform modules"
       depends on MODULES
       depends on MODULE_UNLOAD
       depends on SYSFS
       depends on NAMESPACES
       depends on NET_NS
       depends on INET
       depends on IPV6
       depends on TUN
       depends on NETFILTER
       help
	 Say Y here to enable the building of kernel modules
	 for VMware's Mobile Virtualization Platform

config VMWARE_MVP_DEBUG
       bool "Enable debug for VMware Mobile Virtualization Platform modules"
       depends on VMWARE_MVP
       depends on IKCONFIG_PROC
       help
	 Say Y here to enable debug on kernel modules
	 for VMware's Mobile Virtualization Platform.
	 This should be enabled for eng or userdebug builds.
```

## drivers/gpu/drm/exynos_tmp/Kconfig
```kconfig
config DRM_EXYNOS
	tristate "DRM Support for Samsung SoC EXYNOS Series"
	depends on DRM && PLAT_SAMSUNG
	select DRM_KMS_HELPER
	select FB_CFB_FILLRECT
	select FB_CFB_COPYAREA
	select FB_CFB_IMAGEBLIT
	select VT_HW_CONSOLE_BINDING if FRAMEBUFFER_CONSOLE

config DRM_EXYNOS_MEMSIZE
	int "Memory size in kbytes for DRM"
	depends on DRM_EXYNOS
	default "32768"

config DRM_EXYNOS_FIMD
	bool "Samsung DRM FIMD"
	depends on DRM_EXYNOS

config DRM_EXYNOS_HDMI
	bool "Samsung DRM HDMI"
	depends on DRM_EXYNOS

config DRM_EXYNOS_VIDI
	bool "Samsung DRM Virtual Display"
	depends on DRM_EXYNOS

config DRM_EXYNOS_G2D
	bool "Samsung DRM G2D"
	depends on DRM_EXYNOS
```
